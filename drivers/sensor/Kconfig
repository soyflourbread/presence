## drivers/sensor/Kconfig
```kconfig
# Copyright (c) 2021 Nordic Semiconductor ASA
# SPDX-License-Identifier: Apache-2.0

if SENSOR
rsource "example_sensor/Kconfig"
rsource "ld2412_sensor/Kconfig"
endif # SENSOR
```

## drivers/sensor/ld2412_sensor/Kconfig
```kconfig
menu "Hilink LD2412 presence sensor"

config LD2412_SENSOR
	bool "Enable Hilink LD2412 presence sensor"
	depends on DT_HAS_HILINK_LD2412_SENSOR_ENABLED
	help
	  Enable Hilink LD2412 presence sensor

if LD2412_SENSOR
    config LD2412_SENSOR_THREAD_STACK_SIZE
        int "thread stack size (bytes)"
        default 512
        range 512 2048
        help
            Size of UART RX buffer. Will be allocated for each device.

    config LD2412_SENSOR_RX_BUF_SIZE
        int "rx buffer size (bytes)"
        default 128
        range 0 2048
        help
            Size of UART RX DMA buffer. Will be allocated for each device.

    config LD2412_SENSOR_UART_RING_BUF_SIZE
        int "rx ring buffer size (bytes)"
        default 1024
        range 0 2048
        help
            Size of UART RX ring buffer. Will be allocated for each device.

    config LD2412_SENSOR_FRAME_DATA_MAX_SIZE
        int "frame data max size (bytes)"
        default 256
        range 0 2048
        help
            Max size of frame data.

    config LD2412_SENSOR_GATE_NUM
        int "number of gates supported by presence sensor"
        default 14
        range 1 14
        help
            Number of gates supported by presence sensor.

    module = LD2412_SENSOR
    module-str = Hilink LD2412 presence sensor
    source "subsys/logging/Kconfig.template.log_config"
endif
endmenu
```

## dts/bindings/sensor/hilink,ld2412-sensor.yaml
```yaml
description: |
  Hi-Link LD2412 presence sensor, over UART.
compatible: "hilink,ld2412-sensor"

include: [sensor-device.yaml, uart-device.yaml]
properties:
  initial-string:
    required: false
    type: string
    description: |
      Initial string to be sent over uart. Can be changed during run-time.
```
